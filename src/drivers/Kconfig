## src/drivers/Kconfig
```kconfig
# Custom Drivers Configuration

menu "Custom Drivers"

# Include sensor drivers
rsource "sensor/Kconfig"

endmenu
```

## src/drivers/sensor/Kconfig
```kconfig
# Custom Sensor Drivers

menu "Custom Sensor Drivers"

# Include MAX30102 driver
rsource "max30102/Kconfig"

endmenu
```

## src/drivers/sensor/max30102/Kconfig
```kconfig
# MAX30102 heart rate and SpO2 sensor
# 2-channel sensor (Red + IR LEDs only, no Green LED)

menuconfig MAX30102
	bool "MAX30102 Pulse Oximeter and Heart Rate Sensor"
	default n
	depends on I2C
	help
	  Enable driver for MAX30102 pulse oximeter and heart rate sensor.
	  This is a 2-channel sensor with Red and IR LEDs only.

if MAX30102

config MAX30102_SMP_AVE
	int "Sample averaging"
	range 0 7
	default 0
	help
	  To reduce the amount of data throughput, adjacent samples (in each
	  individual channel) can be averaged and decimated on the chip by
	  setting this register. Set to 0 for no averaging.
	  0 = 1 sample (no averaging)
	  1 = 2 samples
	  2 = 4 samples
	  3 = 8 samples
	  4 = 16 samples
	  5 = 32 samples
	  6 = 32 samples
	  7 = 32 samples

config MAX30102_FIFO_ROLLOVER_EN
	bool "FIFO rolls on full"
	help
	  Controls the behavior of the FIFO when the FIFO becomes completely
	  filled with data. If set, the FIFO address rolls over to zero and the
	  FIFO continues to fill with new data. If not set, then the FIFO is
	  not updated until FIFO_DATA is read or the WRITE/READ pointer
	  positions are changed.

config MAX30102_FIFO_A_FULL
	int "FIFO almost full value"
	range 0 15
	default 15
	help
	  Set the trigger for the FIFO_A_FULL interrupt

choice MAX30102_MODE
	prompt "Mode control"
	default MAX30102_HEART_RATE_MODE

config MAX30102_HEART_RATE_MODE
	bool "Heart rate mode"
	help
	  Set to operate in heart rate only mode. Only the red LED channel is
	  active.

config MAX30102_SPO2_MODE
	bool "SpO2 mode"
	help
	  Set to operate in SpO2 mode. Both red and IR LED channels are active.
	  This is the recommended mode for the MAX30102.

config MAX30102_MULTI_LED_MODE
	bool "Multi-LED mode"
	help
	  Set to operate in multi-LED mode. The red and/or IR LED
	  channels are active. (No green LED on MAX30102)

endchoice

config MAX30102_ADC_RGE
	int "ADC range control"
	range 0 3
	default 0
	help
	  Set the ADC's full-scale range.
	  0 = 2048 nA (lowest noise)
	  1 = 4096 nA
	  2 = 8192 nA
	  3 = 16384 nA (highest range)

config MAX30102_SR
	int "ADC sample rate control"
	range 0 7
	default 1
	help
	  Set the effective sampling rate with one sample consisting of one
	  pulse/conversion per active LED channel. In SpO2 mode, this means
	  one IR pulse/conversion and one red pulse/conversion per sample
	  period.
	  0 = 50 Hz
	  1 = 100 Hz (recommended)
	  2 = 200 Hz
	  3 = 400 Hz
	  4 = 800 Hz
	  5 = 1000 Hz
	  6 = 1600 Hz
	  7 = 3200 Hz

config MAX30102_LED1_PA
	hex "LED1 (red) pulse amplitude"
	range 0 0xff
	default 0x1f
	help
	  Set the pulse amplitude to control the LED1 (red) current.
	  0x00 = 0.0 mA
	  0x01 = 0.2 mA
	  0x02 = 0.4 mA
	  0x0f = 3.1 mA
	  0x1f = 6.2 mA (recommended starting point)
	  0x7f = 25.4 mA
	  0xff = 50.0 mA

config MAX30102_LED2_PA
	hex "LED2 (IR) pulse amplitude"
	range 0 0xff
	default 0x1f
	help
	  Set the pulse amplitude to control the LED2 (IR) current.
	  0x00 = 0.0 mA
	  0x01 = 0.2 mA
	  0x02 = 0.4 mA
	  0x0f = 3.1 mA
	  0x1f = 6.2 mA (recommended starting point)
	  0x7f = 25.4 mA
	  0xff = 50.0 mA

if MAX30102_MULTI_LED_MODE

config MAX30102_SLOT1
	int "Slot 1"
	range 0 4
	default 1
	help
	  Set which LED and pulse amplitude are active in time slot 1.
	  0: None (disabled)
	  1: LED1 (red), LED1_PA
	  2: LED2 (IR), LED2_PA
	  3: LED1 (red), PILOT_PA
	  4: LED2 (IR), PILOT_PA

config MAX30102_SLOT2
	int "Slot 2"
	range 0 4
	default 2
	help
	  Set which LED and pulse amplitude are active in time slot 2.
	  0: None (disabled)
	  1: LED1 (red), LED1_PA
	  2: LED2 (IR), LED2_PA
	  3: LED1 (red), PILOT_PA
	  4: LED2 (IR), PILOT_PA

config MAX30102_SLOT3
	int "Slot 3"
	range 0 4
	default 0
	help
	  Set which LED and pulse amplitude are active in time slot 3.
	  0: None (disabled)
	  1: LED1 (red), LED1_PA
	  2: LED2 (IR), LED2_PA
	  3: LED1 (red), PILOT_PA
	  4: LED2 (IR), PILOT_PA

config MAX30102_SLOT4
	int "Slot 4"
	range 0 4
	default 0
	help
	  Set which LED and pulse amplitude are active in time slot 4.
	  0: None (disabled)
	  1: LED1 (red), LED1_PA
	  2: LED2 (IR), LED2_PA
	  3: LED1 (red), PILOT_PA
	  4: LED2 (IR), PILOT_PA

endif # MAX30102_MULTI_LED_MODE

endif # MAX30102
```
