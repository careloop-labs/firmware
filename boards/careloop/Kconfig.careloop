## boards/careloop/Kconfig.careloop
```kconfig
# Copyright (c) 2026 CareLoop
# SPDX-License-Identifier: Apache-2.0

config BOARD_CARELOOP
	select SOC_NRF52840_QIAA
```

## boards/careloop/careloop_v2/Kconfig.careloop_v2
```kconfig
# Copyright (c) 2026 CareLoop
# SPDX-License-Identifier: Apache-2.0

config BOARD_CARELOOP_V2
	select SOC_NRF52840_QIAA
```

## boards/careloop/careloop_v2/board.yml
```yaml
board:
  name: careloop_v2
  full_name: CareLoop Wearable v2
  vendor: careloop
  socs:
    - name: nrf52840
```

## test/bringup/ble/testcase.yaml
```yaml
common:
  platform_allow:
    - careloop/nrf52840
  build_only: true
  tags:
    - bringup
    - hardware
    - manual
    - level5

tests:
  bringup.ble: {}
```
