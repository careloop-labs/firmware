## CMakeLists.txt
```
cmake_minimum_required(VERSION 3.20.0)

# Standalone app: the careloop board and DT bindings live in the repo root,
# three levels up. Both must be set before find_package(Zephyr) or they are ignored.
get_filename_component(CARELOOP_ROOT ${CMAKE_CURRENT_SOURCE_DIR}/../../.. ABSOLUTE)
list(APPEND BOARD_ROOT ${CARELOOP_ROOT})
list(APPEND DTS_ROOT ${CARELOOP_ROOT})

find_package(Zephyr REQUIRED HINTS $ENV{ZEPHYR_BASE})

project(careloop_boot_test)

target_sources(app PRIVATE src/main.c)
```

## prj.conf
```kconfig
# Boot test. Console (SEGGER RTT) comes from the careloop board defconfig.

CONFIG_LOG=y

# Synchronous logging: output leaves the buffer as it is written, so a hang
# after main() cannot swallow the lines that led up to it.
CONFIG_LOG_MODE_IMMEDIATE=y

# Debuggable via ../debug.sh: -Og keeps locals live, and thread info lets the
# J-Link Zephyr plugin enumerate threads.
CONFIG_DEBUG_OPTIMIZATIONS=y
CONFIG_DEBUG_THREAD_INFO=y
```

## src/main.c
```c
// SPDX-License-Identifier: Apache-2.0
// Copyright (c) 2026 CareLoop Labs

/*
 * careloop boot test.
 *
 * Proves exactly one thing: the image flashes, the CPU resets into it, main()
 * is reached, and log output arrives over RTT. Nothing else - no peripherals,
 * no BLE. If this fails, no other bring-up result can be trusted.
 *
 * The heartbeat is part of the proof: a single banner only shows main() was
 * entered, while a repeating beat shows the kernel scheduler is running.
 */

#include <zephyr/kernel.h>
#include <zephyr/logging/log.h>

LOG_MODULE_REGISTER(boot, LOG_LEVEL_INF);

#define HEARTBEAT_PERIOD_S 1

int main(void)
{
    LOG_INF("careloop boot OK - reached main()");

    for (uint32_t beat = 0U;; beat++) {
        k_sleep(K_SECONDS(HEARTBEAT_PERIOD_S));
        LOG_INF("beat %u", beat);
    }

    return 0;
}
```
