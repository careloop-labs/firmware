## CMakeLists.txt
```
cmake_minimum_required(VERSION 3.20.0)

# Standalone app: the careloop board and DT bindings live in the repo root,
# three levels up. Both must be set before find_package(Zephyr) or they are ignored.
get_filename_component(CARELOOP_ROOT ${CMAKE_CURRENT_SOURCE_DIR}/../../.. ABSOLUTE)
list(APPEND BOARD_ROOT ${CARELOOP_ROOT})
list(APPEND DTS_ROOT ${CARELOOP_ROOT})

find_package(Zephyr REQUIRED HINTS $ENV{ZEPHYR_BASE})

project(careloop_optical)

# The product optical HAL, compiled verbatim. Everything specific to this
# board lives in it - the emitter-to-TX mapping, the reset pulse width, the
# internal-oscillator bit - and none of it can be checked without looking at
# the emitters, so it is checked here or nowhere.
#
# Named explicitly rather than globbed over src/hal, for the same reason the
# LEDs app does: a glob drags in motion, power and skin_temperature and forces
# CONFIG_SENSOR and the whole MFD stack into what is meant to stay minimal.
target_sources(app PRIVATE
    src/main.c
    src/detector.c
    ${CARELOOP_ROOT}/src/hal/optical_afe4404.c
)

# hal/optical_afe4404.c includes <optical.h>, which includes "errors.h" from src/.
target_include_directories(app PRIVATE
    ${CARELOOP_ROOT}/src
    ${CARELOOP_ROOT}/src/hal/include
)
```

## prj.conf
```kconfig
# Optical front end exerciser. Console (SEGGER RTT) comes from the careloop
# board defconfig.

CONFIG_LOG=y

# Synchronous logging: output leaves the buffer as it is written, so the phase
# banner is on screen before the phase it announces starts, not after.
CONFIG_LOG_MODE_IMMEDIATE=y

# The RTT up-buffer defaults to 1024 B in NO_BLOCK_SKIP mode. This app prints
# a countdown per phase over a run of about a minute.
CONFIG_SEGGER_RTT_BUFFER_SIZE_UP=4096

# The AFE is on I2C; RESETZ is a GPIO; TX_SUP is a fixed regulator on a GPIO.
# REGULATOR_FIXED is what enables the +5V boost - without it the AFE still
# answers and every call still returns 0, but no emitter can draw current.
CONFIG_I2C=y
CONFIG_GPIO=y
CONFIG_REGULATOR=y
CONFIG_REGULATOR_FIXED=y

# The detector phases overflow the 1024-byte default and hard-fault with an MPU
# stack-overflow in phase_baseline. Each phase function carries a ~196-byte
# frame of statistics, they nest three deep through collect() into the I2C
# read, and CONFIG_LOG_MODE_IMMEDIATE above formats every line on this same
# stack rather than a log thread's. Measured, not guessed: the emitter-only
# version of this app fitted in 1024 with almost nothing to spare, and one
# added log line was enough to fault it.
CONFIG_MAIN_STACK_SIZE=4096

# Debuggable via ../debug.sh: -Og keeps locals live, and thread info lets the
# J-Link Zephyr plugin enumerate threads.
CONFIG_DEBUG_OPTIMIZATIONS=y
CONFIG_DEBUG_THREAD_INFO=y
```

## src/main.c
```c
// SPDX-License-Identifier: Apache-2.0
// Copyright (c) 2026 CareLoop Labs

/*
 * careloop optical path exerciser.
 *
 * Two halves, in order. First the emitters: green, red and IR one at a time
 * through the AFE4404, then all three together. Then the detector phases in
 * detector.c, which read light back through the SFH7074's photodiode.
 *
 * The emitter half is a bring-up tool rather than a test - it answers "does
 * the AFE answer, and does anything light up" and stops there. A ztest cannot
 * close that loop: every write below returns 0 on a board where the boost is
 * dead, the emitters are unpopulated, or RESETZ is held low by a misconfigured
 * pin, because the AFE ACKs off RX_SUP and IO_SUP alone and ACKing is the only
 * thing firmware can observe. Only a person looking at the emitter closes it.
 *
 * The detector half does produce verdicts, because a photodiode reading is
 * something firmware can actually check. It still needs an operator - two of
 * its three phases ask for a hand or a finger over the sensor - so it prints
 * what it wants and when, and reports PASS or FAIL per phase.
 *
 * How to watch it, in order of how much it tells you:
 *
 *   Green and red are directly visible, but dimly - each emitter is on for
 *   100 us out of every 10 ms, so about 1% of the time. Look at the SFH7074
 *   package itself in a dim room, not at the board from across the bench.
 *
 *   IR is invisible to the eye. Most phone cameras see it as a faint white
 *   or violet dot; front-facing cameras usually work better than rear ones,
 *   which tend to have stronger IR-cut filters.
 *
 *   A current meter in series with the battery is the more reliable check,
 *   and the ALL phase is the one to use it on.
 *
 * If nothing lights, the order to suspect things in:
 *
 *   1. The +5V boost (U8). It feeds both TX_SUP and the emitter common
 *      anode, and the AFE answers on I2C without it. optical_init() enables
 *      it, but nothing here can read the rail back.
 *   2. Jumper J3. +3V3 reaches the AFE's RX_SUP only through it, and BUCK2
 *      senses upstream, so the PMIC reports the rail healthy either way.
 *      That is how the first board failed the LED bring-up.
 *   3. RESETZ (P0.26). Its net is called AFE_INT2, which is wrong - it is an
 *      output. Held low, the AFE never comes out of reset and does not ACK,
 *      so init would have failed loudly rather than reaching the phases.
 *
 * Currents are deliberately below each emitter's DC rating rather than at the
 * AFE's 50 mA full scale; the HAL enforces the ceiling, this only stays well
 * inside it. Even so, do not leave the ALL phase running against skin.
 *
 * Run it with:
 *   ./scripts/bringup.sh optical
 */

#include <zephyr/kernel.h>
#include <zephyr/logging/log.h>
#include <zephyr/sys/util.h>

#include <optical.h>

#include "phases.h"

/*
 * Not "optical": src/hal/optical_afe4404.c already registers that module
 * name, and this image links both. Two LOG_MODULE_REGISTER of one name is a
 * duplicate symbol at link time.
 */
LOG_MODULE_REGISTER(optical_app, LOG_LEVEL_INF);

/* Long enough to settle a meter on, and to hunt for a dim dot in a dark room. */
#define PHASE_S 10U
#define PHASE_GAP_MS 800U

/* Comfortably inside every per-emitter ceiling the HAL enforces. */
#define DRIVE_UA 20000U

static const char *const emitter_name[OPTICAL_EMITTER_COUNT] = {
	[OPTICAL_EMITTER_GREEN] = "GREEN",
	[OPTICAL_EMITTER_RED] = "RED",
	[OPTICAL_EMITTER_IR] = "IR",
};

/* Appended to the phase banner, so each phase says how to observe it. */
static const char *const emitter_hint[OPTICAL_EMITTER_COUNT] = {
	[OPTICAL_EMITTER_GREEN] = "look at the SFH7074 in a dim room",
	[OPTICAL_EMITTER_RED] = "look at the SFH7074 in a dim room",
	[OPTICAL_EMITTER_IR] = "invisible - use a phone camera",
};

static int all_off(void)
{
	for (uint8_t i = 0; i < OPTICAL_EMITTER_COUNT; i++) {
		int err = optical_set_current_ua((enum optical_emitter)i, 0U);

		if (err) {
			LOG_ERR("clearing emitter %u failed (%d)", i, err);
			return err;
		}
	}

	return 0;
}

/* Counts down so it is obvious how much of a phase is left to look at. */
static void hold(uint32_t seconds)
{
	for (uint32_t s = seconds; s > 0U; s--) {
		LOG_INF("    %u", s);
		k_sleep(K_SECONDS(1));
	}
}

static int phase_single(enum optical_emitter emitter)
{
	int err;

	LOG_INF("phase: %s at %u uA - %s", emitter_name[emitter], DRIVE_UA,
		emitter_hint[emitter]);

	err = optical_set_current_ua(emitter, DRIVE_UA);
	if (err) {
		LOG_ERR("set current failed (%d)", err);
		return err;
	}

	hold(PHASE_S);

	err = optical_set_current_ua(emitter, 0U);
	if (err) {
		LOG_ERR("clear current failed (%d)", err);
		return err;
	}

	k_msleep(PHASE_GAP_MS);

	return 0;
}

static int phase_all(void)
{
	int err;

	LOG_INF("phase: ALL three at %u uA - the one to put a meter on", DRIVE_UA);

	for (uint8_t i = 0; i < OPTICAL_EMITTER_COUNT; i++) {
		err = optical_set_current_ua((enum optical_emitter)i, DRIVE_UA);
		if (err) {
			LOG_ERR("set emitter %u failed (%d)", i, err);
			return err;
		}
	}

	hold(PHASE_S);

	return all_off();
}

int main(void)
{
	int err;

	LOG_INF("careloop optical bring-up");

	err = optical_init();
	if (err) {
		/*
		 * Stop here rather than carrying on. Past this point every
		 * call would fail the same way, and a screen of identical
		 * errors buries the one that says what actually happened.
		 */
		LOG_ERR("optical_init failed (%d) - see the header of this file", err);
		return 0;
	}

	/*
	 * Report the limits the HAL will enforce before driving anything, so
	 * the numbers in the phases below can be checked against them without
	 * reading the source.
	 */
	uint32_t step_ua = 0U;

	if (optical_get_current_step_ua(&step_ua) == 0) {
		LOG_INF("current step %u uA", step_ua);
	}

	for (uint8_t i = 0; i < OPTICAL_EMITTER_COUNT; i++) {
		uint32_t max_ua = 0U;

		if (optical_get_max_current_ua((enum optical_emitter)i, &max_ua) == 0) {
			LOG_INF("  %-8s max %u uA", emitter_name[i], max_ua);
		}
	}

	err = optical_start();
	if (err) {
		LOG_ERR("optical_start failed (%d)", err);
		return 0;
	}

	LOG_INF("timing engine running, emitters dark");
	k_msleep(PHASE_GAP_MS);

	/*
	 * Green first: it is the brightest of the two visible emitters, so if
	 * exactly one phase is going to be seen on a marginal setup, this is
	 * the one.
	 */
	static const enum optical_emitter order[] = {
		OPTICAL_EMITTER_GREEN,
		OPTICAL_EMITTER_RED,
		OPTICAL_EMITTER_IR,
	};

	for (size_t i = 0; i < ARRAY_SIZE(order); i++) {
		if (phase_single(order[i]) != 0) {
			break;
		}
	}

	(void)phase_all();

	/*
	 * Detector phases run with the sequence still going and every emitter
	 * dark, which is the state phase_all() leaves behind. They own the
	 * gain from here on, so nothing above should assume it is still at the
	 * value optical_init() loaded.
	 */
	bool detector_ok = detector_run(DRIVE_UA);

	/*
	 * Stop rather than loop. This is meant to be watched, and emitters
	 * left pulsing on a bench after everyone has stopped looking only burn
	 * the cell. Reset the board to run it again - the image stays flashed.
	 */
	err = optical_stop();
	if (err) {
		LOG_ERR("optical_stop failed (%d)", err);
	}

	LOG_INF("done - emitters dark, timing engine stopped");
	LOG_INF("detector verdict: %s", detector_ok ? "PASS" : "FAIL - see above");

	return 0;
}
```

## src/detector.c
```c
// SPDX-License-Identifier: Apache-2.0
// Copyright (c) 2026 CareLoop Labs

/*
 * Photodetector phases of the optical bring-up.
 *
 * There is exactly one detector on this board: the SFH7074's broadband PD3,
 * cathode to the AFE's INP, INM to ground. PD1 and PD2 - the two IR-cut
 * diodes - are not connected to anything, so nothing here can cross-check
 * one diode against another. Everything below reads the same photodiode
 * through four time slots.
 *
 * The three phases answer three separate questions, in increasing order of
 * how much has to be working:
 *
 *   1. baseline   Does the receiver convert at all? Needs the photodiode,
 *                 the TIA, the ADC and the timing engine, but no light and
 *                 no emitter. A stuck reading here is the one failure that
 *                 cannot be blamed on the room or the operator.
 *
 *   2. ambient    Does the detector respond to light? Needs the optics to be
 *                 unobstructed. Emitters stay dark, so this passes or fails
 *                 independently of the whole transmit path - which is what
 *                 makes it worth running even when the emitters are known
 *                 good.
 *
 *   3. reflectance Does light get from an emitter, off something, and back
 *                 into the detector? This is the actual PPG loop and the
 *                 only phase that proves the two halves are optically
 *                 coupled rather than merely alive.
 *
 * Phase 3 measures GREEN minus AMBIENT, not GREEN. A finger over the sensor
 * does two opposite things at once: it blocks room light, pushing the raw
 * reading down, and it reflects emitter light, pushing it up. Those partly
 * cancel, so raw GREEN can move either way and a threshold on it would be
 * measuring the room. The difference isolates the emitter's own contribution,
 * which only moves one way.
 *
 * Gain is auto-ranged rather than fixed because the right value depends
 * entirely on the room. At 500 kohm the broadband diode reaches a large
 * fraction of full scale under ordinary office light, so a fixed gain either
 * saturates on a bright bench or wastes range in a dim one, and both look
 * like a broken detector.
 *
 * Every threshold here is measured, not absolute, and that is the whole
 * reason phase 1 exists. An earlier version gated phase 2 on a fixed 1% of
 * full scale and passed with nobody in the room: the undisturbed ambient
 * reading already swung by 7% of full scale on its own, so the phase could
 * not fail. Mains lighting flickers at 100 Hz and the sequence runs at
 * 100 Hz, which aliases that flicker down to near-DC and produces exactly
 * that kind of large slow swing. So phase 1 measures the undisturbed
 * variation and the later phases must beat a multiple of it. A threshold
 * that a still, empty bench can clear is not a test.
 */

#include "phases.h"

#include <stdlib.h>

#include <zephyr/kernel.h>
#include <zephyr/logging/log.h>
#include <zephyr/sys/util.h>

#include <optical.h>

LOG_MODULE_DECLARE(optical_app, LOG_LEVEL_INF);

#define SAMPLE_PERIOD_MS 20U /* 50 Hz against a 100 Hz sequence */

#define BASELINE_MS 2000U
#define AMBIENT_MS 8000U
#define REFLECT_MS 8000U
#define SETTLE_MS 3000U /* operator reaction time before a measured window */

/*
 * Gains to try, brightest-tolerant last. Auto-ranging walks this in order
 * and keeps the first that leaves headroom, so the list must stay descending
 * - the AFE's own register order is not monotonic and must not be used here.
 */
static const uint32_t gain_ladder_ohms[] = {
	2000000U, 1000000U, 500000U, 250000U, 100000U, 50000U, 25000U, 10000U,
};

/* Keep this much of full scale unused, so a signal added later still fits. */
#define HEADROOM_PERCENT 70

/*
 * How far above the undisturbed variation a response has to rise to count.
 * Three is chosen to sit clear of the flicker without demanding much: a hand
 * over the sensor changes the reading by most of full scale, hundreds of
 * times the noise, so a real response clears this by a wide margin and only
 * an absent operator fails it.
 */
#define NOISE_MULTIPLE 3

struct chan_stats {
	int32_t min;
	int32_t max;
	int64_t sum;
	uint32_t count;
	bool varied; /* false if every sample was bit-identical */
	int32_t first;
};

static const char *const channel_name[OPTICAL_CHANNEL_COUNT] = {
	[OPTICAL_CHANNEL_GREEN] = "GREEN",
	[OPTICAL_CHANNEL_RED] = "RED",
	[OPTICAL_CHANNEL_IR] = "IR",
	[OPTICAL_CHANNEL_AMBIENT] = "AMBIENT",
};

static void stats_reset(struct chan_stats *s)
{
	s->min = INT32_MAX;
	s->max = INT32_MIN;
	s->sum = 0;
	s->count = 0U;
	s->varied = false;
	s->first = 0;
}

static void stats_add(struct chan_stats *s, int32_t v)
{
	if (s->count == 0U) {
		s->first = v;
	} else if (v != s->first) {
		s->varied = true;
	}

	if (v < s->min) {
		s->min = v;
	}
	if (v > s->max) {
		s->max = v;
	}

	s->sum += v;
	s->count++;
}

static int32_t stats_mean(const struct chan_stats *s)
{
	if (s->count == 0U) {
		return 0;
	}

	return (int32_t)(s->sum / (int64_t)s->count);
}

static int32_t stats_range(const struct chan_stats *s)
{
	if (s->count == 0U) {
		return 0;
	}

	return s->max - s->min;
}

/*
 * Collect one window. Fills per-channel stats plus the GREEN-AMBIENT
 * difference, and ORs together every saturation flag seen - a channel that
 * clipped even once during the window has an untrustworthy min or max, so
 * the flag has to survive the whole window rather than reflect the last
 * sample.
 */
static int collect(uint32_t duration_ms, struct chan_stats chan[OPTICAL_CHANNEL_COUNT],
		   struct chan_stats *green_minus_ambient, uint8_t *saturated)
{
	uint32_t iterations = duration_ms / SAMPLE_PERIOD_MS;

	for (uint8_t i = 0; i < OPTICAL_CHANNEL_COUNT; i++) {
		stats_reset(&chan[i]);
	}
	stats_reset(green_minus_ambient);
	*saturated = 0U;

	for (uint32_t n = 0; n < iterations; n++) {
		struct optical_sample s;
		int err = optical_read(&s);

		if (err) {
			LOG_ERR("optical_read failed (%d)", err);
			return err;
		}

		for (uint8_t i = 0; i < OPTICAL_CHANNEL_COUNT; i++) {
			stats_add(&chan[i], s.code[i]);
		}

		stats_add(green_minus_ambient,
			  s.code[OPTICAL_CHANNEL_GREEN] - s.code[OPTICAL_CHANNEL_AMBIENT]);

		*saturated |= s.saturated;

		k_msleep(SAMPLE_PERIOD_MS);
	}

	return 0;
}

static void report(const char *label, const struct chan_stats *s)
{
	LOG_INF("    %-14s min %8d  max %8d  mean %8d  range %8d", label, s->min, s->max,
		stats_mean(s), stats_range(s));
}

/* Counts down so the operator knows how long to keep doing something. */
static void prompt_countdown(uint32_t seconds)
{
	for (uint32_t s = seconds; s > 0U; s--) {
		LOG_INF("    %u", s);
		k_sleep(K_SECONDS(1));
	}
}

/*
 * Pick the highest gain that leaves the ambient channel inside HEADROOM_PERCENT
 * of full scale. Walks down from the top rather than computing a gain from one
 * reading, because a saturated reading carries no magnitude information - it is
 * a rail - so there is nothing to compute from until the signal is back in
 * range.
 */
static int autorange(int32_t full_scale, uint32_t *chosen_ohms)
{
	int32_t limit = (int32_t)(((int64_t)full_scale * HEADROOM_PERCENT) / 100);

	for (size_t i = 0; i < ARRAY_SIZE(gain_ladder_ohms); i++) {
		struct chan_stats chan[OPTICAL_CHANNEL_COUNT];
		struct chan_stats diff;
		uint8_t saturated;
		int err;

		err = optical_set_gain_ohms(gain_ladder_ohms[i]);
		if (err) {
			LOG_ERR("set gain failed (%d)", err);
			return err;
		}

		/* Let the TIA settle over a few sequence periods before
		 * judging the result of the change. */
		k_msleep(100);

		err = collect(200U, chan, &diff, &saturated);
		if (err) {
			return err;
		}

		int32_t peak = MAX(abs(chan[OPTICAL_CHANNEL_AMBIENT].max),
				   abs(chan[OPTICAL_CHANNEL_AMBIENT].min));
		bool ambient_saturated = (saturated & BIT(OPTICAL_CHANNEL_AMBIENT)) != 0U;

		if (!ambient_saturated && peak < limit) {
			(void)optical_get_gain_ohms(chosen_ohms);
			LOG_INF("    gain %u ohm, ambient peak %d of %d", *chosen_ohms, peak,
				full_scale);
			return 0;
		}
	}

	/*
	 * Even the lowest gain clips. That is a real result, not an error -
	 * it means the detector is being flooded, which is what a bare sensor
	 * under a desk lamp looks like.
	 */
	(void)optical_get_gain_ohms(chosen_ohms);
	LOG_WRN("    ambient still saturating at the lowest gain (%u ohm) - shade the sensor",
		*chosen_ohms);

	return 0;
}

static bool phase_baseline(int32_t full_scale, int32_t *noise_floor)
{
	struct chan_stats chan[OPTICAL_CHANNEL_COUNT];
	struct chan_stats diff;
	uint8_t saturated;
	bool ok = true;

	LOG_INF("detector 1/3: baseline - emitters dark, do not touch the sensor");

	if (collect(BASELINE_MS, chan, &diff, &saturated) != 0) {
		return false;
	}

	for (uint8_t i = 0; i < OPTICAL_CHANNEL_COUNT; i++) {
		report(channel_name[i], &chan[i]);
	}

	/*
	 * A channel that never changes by even one count is the signature of a
	 * receiver that is not converting - a stalled timing engine, or the
	 * internal oscillator never enabled. Real conversions always carry
	 * noise in the low bits, so bit-identical samples over two seconds are
	 * not a quiet room, they are a dead ADC.
	 */
	if (!chan[OPTICAL_CHANNEL_AMBIENT].varied) {
		LOG_ERR("    FAIL ambient never changed (%d every sample) - the ADC is not "
			"converting; suspect the timing engine or OSC_ENABLE",
			chan[OPTICAL_CHANNEL_AMBIENT].first);
		ok = false;
	}

	/*
	 * With every emitter dark all four slots look at the same darkness, so
	 * they should agree. A wide spread means a slot is picking up something
	 * that is not light - most likely a timing phase overlapping an emitter
	 * window or an ADC reset.
	 */
	int32_t lo = INT32_MAX;
	int32_t hi = INT32_MIN;

	for (uint8_t i = 0; i < OPTICAL_CHANNEL_COUNT; i++) {
		lo = MIN(lo, stats_mean(&chan[i]));
		hi = MAX(hi, stats_mean(&chan[i]));
	}

	int32_t spread_limit = full_scale / 20; /* 5% of range */

	if ((hi - lo) > spread_limit) {
		LOG_WRN("    channels disagree by %d with all emitters dark (limit %d) - "
			"suspect the phase timing",
			hi - lo, spread_limit);
	}

	if (saturated != 0U) {
		LOG_WRN("    saturated channels mask 0x%02x even after auto-ranging", saturated);
	}

	/*
	 * What the later phases must beat. Taken from the ambient channel with
	 * nothing happening, so it captures whatever the room is already doing
	 * to the detector - flicker, drift, converter noise - as one number.
	 */
	*noise_floor = stats_range(&chan[OPTICAL_CHANNEL_AMBIENT]);
	LOG_INF("    undisturbed variation %d counts - later phases must beat %dx this",
		*noise_floor, NOISE_MULTIPLE);

	LOG_INF("    %s", ok ? "PASS the receiver is converting" : "FAIL");

	return ok;
}

static bool phase_ambient(int32_t full_scale, int32_t noise_floor)
{
	struct chan_stats chan[OPTICAL_CHANNEL_COUNT];
	struct chan_stats diff;
	uint8_t saturated;

	LOG_INF("detector 2/3: ambient response - emitters stay dark");
	LOG_INF("  WAVE YOUR HAND over the sensor, or cover and uncover it, for %u s",
		AMBIENT_MS / 1000U);
	prompt_countdown(SETTLE_MS / 1000U);
	LOG_INF("  ... measuring now");

	if (collect(AMBIENT_MS, chan, &diff, &saturated) != 0) {
		return false;
	}

	report("AMBIENT", &chan[OPTICAL_CHANNEL_AMBIENT]);

	/*
	 * A multiple of what the bench does on its own, floored at 1% of full
	 * scale so a freak dark room cannot make the bar trivially low.
	 * Covering the diode with a hand changes the photocurrent by orders of
	 * magnitude, so a genuine response clears this easily.
	 */
	int32_t threshold = MAX(noise_floor * NOISE_MULTIPLE, full_scale / 100);
	int32_t range = stats_range(&chan[OPTICAL_CHANNEL_AMBIENT]);

	if (range < threshold) {
		LOG_ERR("    FAIL ambient moved by %d, needed %d - either nothing passed over "
			"the sensor, or the detector is not seeing light (suspect PD3, its INP "
			"connection, or an obstructed optical path)",
			range, threshold);
		return false;
	}

	LOG_INF("    PASS ambient moved by %d (needed %d)", range, threshold);

	return true;
}

static bool phase_reflectance(int32_t full_scale, uint32_t drive_ua)
{
	struct chan_stats chan[OPTICAL_CHANNEL_COUNT];
	struct chan_stats diff;
	uint8_t saturated;
	int32_t uncovered_mean;

	LOG_INF("detector 3/3: reflectance - GREEN at %u uA", drive_ua);

	if (optical_set_current_ua(OPTICAL_EMITTER_GREEN, drive_ua) != 0) {
		LOG_ERR("    could not set green current");
		return false;
	}

	k_msleep(100);

	/* Reference with nothing in front of the sensor. */
	LOG_INF("  keep the sensor CLEAR - measuring the unloaded reference");
	if (collect(1000U, chan, &diff, &saturated) != 0) {
		return false;
	}
	uncovered_mean = stats_mean(&diff);
	int32_t reference_spread = stats_range(&diff);

	report("GREEN-AMBIENT", &diff);

	/*
	 * With nothing in front of the sensor this level is optical crosstalk:
	 * emitter light reaching the diode inside the package instead of via
	 * the target. It is reported because it is a fixed cost against the
	 * converter's range - whatever it takes, the reflected signal has to
	 * fit in what is left - and because a sudden change in it between
	 * boards points at the optical barrier rather than the electronics.
	 */
	LOG_INF("    crosstalk (no target): %d counts, %d%% of full scale", uncovered_mean,
		(int32_t)(((int64_t)uncovered_mean * 100) / full_scale));

	LOG_INF("  now PRESS A FINGER firmly over the sensor and hold it for %u s",
		REFLECT_MS / 1000U);
	prompt_countdown(SETTLE_MS / 1000U);
	LOG_INF("  ... measuring now");

	if (collect(REFLECT_MS, chan, &diff, &saturated) != 0) {
		return false;
	}

	report("GREEN-AMBIENT", &diff);
	report("GREEN raw", &chan[OPTICAL_CHANNEL_GREEN]);
	report("AMBIENT raw", &chan[OPTICAL_CHANNEL_AMBIENT]);

	int32_t covered_mean = stats_mean(&diff);
	int32_t delta = covered_mean - uncovered_mean;

	/*
	 * Measured against the reference window's own spread, not a fraction of
	 * full scale. The two means are compared directly, so the question is
	 * whether the shift is bigger than the wobble already present in the
	 * quantity being differenced - and that wobble is what the reference
	 * window just measured.
	 */
	int32_t threshold = MAX(reference_spread * NOISE_MULTIPLE, full_scale / 200);

	if (saturated != 0U) {
		LOG_WRN("    saturated channels mask 0x%02x - lower the gain or the current",
			saturated);
	}

	if (delta < threshold) {
		LOG_ERR("    FAIL reflected green changed by %d, needed %d - either no finger "
			"was applied, or emitter and detector are not optically coupled "
			"(check nothing is between them and that the finger covered the "
			"whole package)",
			delta, threshold);
		(void)optical_set_current_ua(OPTICAL_EMITTER_GREEN, 0U);
		return false;
	}

	LOG_INF("    PASS reflected green rose by %d (needed %d)", delta, threshold);

	/*
	 * Peak-to-peak over the window, next to the noise it has to be judged
	 * against. Deliberately not called the pulse and deliberately not
	 * gated on: at this PRF the aliased mains flicker lands in the same
	 * band as a heart rate, so this number is only suggestive of a PPG
	 * when it stands well clear of the reference spread. A still finger, a
	 * cold hand or a loose contact all suppress a real pulse without
	 * meaning the hardware is faulty.
	 */
	LOG_INF("    peak-to-peak %d against a reference spread of %d - suggestive of a pulse "
		"only if it clearly exceeds it",
		stats_range(&diff), reference_spread);

	(void)optical_set_current_ua(OPTICAL_EMITTER_GREEN, 0U);

	return true;
}

bool detector_run(uint32_t drive_ua)
{
	int32_t full_scale = 0;
	uint32_t gain_ohms = 0U;
	bool ok = true;
	int err;

	err = optical_get_full_scale_code(&full_scale);
	if (err) {
		LOG_ERR("full scale query failed (%d)", err);
		return false;
	}

	LOG_INF("--- photodetector (SFH7074 PD3, broadband; PD1/PD2 are not wired) ---");
	LOG_INF("  full scale %d counts", full_scale);

	LOG_INF("detector 0/3: auto-ranging the gain against the room");
	if (autorange(full_scale, &gain_ohms) != 0) {
		return false;
	}

	int32_t noise_floor = 0;

	ok &= phase_baseline(full_scale, &noise_floor);
	ok &= phase_ambient(full_scale, noise_floor);
	ok &= phase_reflectance(full_scale, drive_ua);

	return ok;
}
```

## src/phases.h
```c
// SPDX-License-Identifier: Apache-2.0
// Copyright (c) 2026 CareLoop Labs

/*
 * Phases of the optical bring-up app, split by which half of the optical
 * path they exercise. main.c owns the emitters and the ordering; detector.c
 * owns everything that reads light back.
 */

#ifndef BRINGUP_OPTICAL_PHASES_H_
#define BRINGUP_OPTICAL_PHASES_H_

#include <stdbool.h>
#include <stdint.h>

/**
 * @brief Run the photodetector phases.
 *
 * Assumes the caller has already brought the front end up and started the
 * sequence, and leaves every emitter dark on return.
 *
 * @param drive_ua Emitter current to use for the reflectance phase.
 * @return true if every phase that can produce a verdict passed.
 */
bool detector_run(uint32_t drive_ua);

#endif /* BRINGUP_OPTICAL_PHASES_H_ */
```
