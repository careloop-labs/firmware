## CMakeLists.txt
```
cmake_minimum_required(VERSION 3.20.0)

# Standalone app: the careloop board lives in the repo root, three levels up.
# Must be set before find_package(Zephyr) or it is ignored. Twister is given
# the same roots on its command line by scripts/bringup.sh, because sysbuild - which
# Twister does not use here - would otherwise configure before this runs.
get_filename_component(CARELOOP_ROOT ${CMAKE_CURRENT_SOURCE_DIR}/../../.. ABSOLUTE)
list(APPEND BOARD_ROOT ${CARELOOP_ROOT})
list(APPEND DTS_ROOT ${CARELOOP_ROOT})

find_package(Zephyr REQUIRED HINTS $ENV{ZEPHYR_BASE})

project(careloop_bringup)

# The product HAL, compiled verbatim - the careloop_hal_* suites exist to test
# *that* code rather than a parallel copy of it. Globbed for the same reason
# test/bringup/ble globs src/communication: a new hal/*.c silently missing from
# this image is exactly the drift these tests are here to catch.
#
# src/hal only. A glob over src/ would pull in src/main.c, whose main() collides
# with the one ztest supplies.
file(GLOB_RECURSE CARELOOP_HAL_SOURCES ${CARELOOP_ROOT}/src/hal/*.c)

target_sources(app PRIVATE
    src/main.c
    src/test_mcu.c
    src/test_clocks.c
    src/test_i2c.c
    src/test_temperature.c
    src/test_imu.c
    src/test_power.c
    src/test_leds.c
    src/test_hal_uninit.c
    src/test_hal_temperature.c
    src/test_hal_motion.c
    src/test_hal_motion_fifo.c
    src/test_hal_power.c
    src/test_hal_leds.c
    ${CARELOOP_HAL_SOURCES}
)

# clock_measure.h is shared verbatim with test/bringup/clocks, the standalone
# A/B that can also run on a DK. The careloop numbers are only worth taking
# if the control board is measured by exactly the same code.
target_include_directories(app PRIVATE ${CMAKE_CURRENT_SOURCE_DIR}/../common)

# Both roots are needed: hal/*.c include their own headers as <power.h>,
# <motion.h> and so on, while those headers include "errors.h" from src/.
target_include_directories(app PRIVATE
    ${CARELOOP_ROOT}/src
    ${CARELOOP_ROOT}/src/hal/include
)
```

## prj.conf
```kconfig
# CareLoop hardware bring-up suite.
# Console (SEGGER RTT) comes from the careloop board defconfig.

CONFIG_ZTEST=y
CONFIG_ZTEST_SHUFFLE=n

CONFIG_LOG=y
CONFIG_LOG_MODE_IMMEDIATE=y

# Block rather than drop when the RTT buffer fills. Twister attaches
# scripts/rtt_console.py before flashing, so a reader is always draining;
# with the default NO_BLOCK_SKIP a slow reader silently loses test output,
# which surfaces as a flaky suite rather than an honest failure.
CONFIG_SEGGER_RTT_MODE_BLOCK_IF_FIFO_FULL=y
CONFIG_SEGGER_RTT_BUFFER_SIZE_UP=16384

CONFIG_I2C=y
CONFIG_GPIO=y
CONFIG_SENSOR=y

# test_i2c_bus_scan NAKs ~110 times per pass by design. CONFIG_I2C_LOG_LEVEL_OFF
# would be the obvious way to quieten that, but it fails to link: the nrfx TWIM
# shim still references its log const. WRN is the strongest level that both
# links and keeps per-NAK chatter out of the report.
CONFIG_I2C_LOG_LEVEL_WRN=y

CONFIG_TMP11X=y
CONFIG_BMI270=y

# Parity with the product prj.conf, which is why CONFIG_BMI270_TRIGGER is
# deliberately absent here too. The suite exists to verify the HAL that ships,
# so building it against a different trigger configuration is the single
# failure mode a bring-up suite must not have.
#
# The product turns the vendor driver's trigger support off because
# src/hal/motion_bmi270_ext.c owns both interrupt pins: any-motion and
# no-motion are distinguished only by INT_STATUS_0, which is read-to-clear,
# and the driver's bmi270_thread_cb() consumes it on every INT1 edge before
# checking whether a handler exists. Interrupts still work - the extension
# maps and services them - so careloop_hal_2_motion's data-ready test still
# has something to prove.
#
# INT1 is P1.15, INT2 is P0.09 - an NFC pin, freed by nfct-pins-as-gpios in
# careloop.dts, which reaches UICR only after a full erase and a power cycle.

CONFIG_MFD=y
CONFIG_MFD_NPM13XX=y
CONFIG_REGULATOR=y
CONFIG_REGULATOR_NPM13XX=y
CONFIG_REGULATOR_FIXED=y
CONFIG_NPM13XX_CHARGER=y

# LED_NPM13XX defaults on from the devicetree node.
CONFIG_LED=y

CONFIG_DEBUG_THREAD_INFO=y
```

## src/main.c
```c
// SPDX-License-Identifier: Apache-2.0
// Copyright (c) 2026 CareLoop Labs

/*
 * CareLoop hardware bring-up suite.
 *
 * One image, one flash, every check. Split across src/test_*.c by hardware
 * domain; this file only owns the suite and the banner.
 *
 * Run it through Twister rather than by hand:
 *   ./scripts/bringup.sh suite
 *
 * Console is SEGGER RTT - the wearable exposes no UART pads - so Twister
 * reaches it through scripts/rtt_console.py as a --device-serial-pty.
 */

#include <zephyr/init.h>
#include <zephyr/kernel.h>
#include <zephyr/ztest.h>

/*
 * The banner used to be the single suite's setup function. With twelve suites
 * there is no one place to hang it, and repeating it per suite would bury the
 * results - so print it from SYS_INIT, which runs before ztest starts.
 *
 * The expected order is printed with it because nothing else states it in one
 * place. ztest runs suites in alphabetical order of the linker symbol, not link
 * order, so the digit in each name is what fixes the sequence - and the two
 * families are numbered independently, so no single name tells you where it
 * sits globally. A report whose order differs from this block is the symptom of
 * a rename, and it is otherwise very hard to notice.
 *
 * Two layers, deliberately kept apart. careloop_<n>_* drive the Zephyr drivers
 * directly and localise a fault to bus, part or configuration.
 * careloop_hal_<n>_* drive src/hal, the code the product actually ships, and
 * verify the contracts in its headers. A failure in one layer but not the other
 * is the most useful signal this suite produces.
 */
static int bringup_banner(void)
{
    printk("\nCareLoop Hardware Bring-up\n");
    printk("==========================\n");
    printk("expected order:\n");
    printk("  board   1_mcu 2_clocks 3_i2c 4_temperature 5_imu 6_power 7_leds\n");
    printk("  hal     hal_0_uninit hal_1_temperature hal_2_motion"
           " hal_3_power hal_4_leds\n\n");

    return 0;
}

SYS_INIT(bringup_banner, APPLICATION, CONFIG_APPLICATION_INIT_PRIORITY);
```

## src/test_clocks.c
```c
// SPDX-License-Identifier: Apache-2.0
// Copyright (c) 2026 CareLoop Labs

/*
 * Clock bring-up.
 *
 * Two crystals, and BLE needs both: Y4 (32.768 kHz, LFXO) times the sleep
 * windows between connection events, Y3 (32 MHz, HFXO) sets the carrier
 * frequency. The Bluetooth spec allows +-50 ppm on the active clock and
 * whatever accuracy the controller *declares* on the sleep clock - and
 * careloop_defconfig declares 20 ppm.
 *
 * These tests exist because the radio on careloop does not work in either
 * direction while an nRF52840 DK a few centimetres away works perfectly with
 * the identical image. A clock fault explains that symmetry; attenuation does
 * not, because attenuation is not symmetric between transmit and receive in
 * the way observed.
 *
 * The ratio alone names no culprit - it is one number from two oscillators,
 * and both internal RC oscillators are far too coarse (HFINT +-1.5%, LFRC
 * +-2% calibrated) to arbitrate an error of well under one part in a
 * thousand. HFXO *startup time* does name one: it involves only the 32 MHz
 * circuit - Y3, its load capacitors and the SoC's drive - with Y4 playing no
 * part at all.
 *
 * Measured 2026-08-17, this board against an nRF52840 DK running the identical
 * code from test/bringup/clocks:
 *
 *              HFXO startup   ratio
 *   careloop@2.0   2929 us   717 ppm
 *   nRF52840 DK     335 us     4 ppm
 *
 * The DK reading 4 ppm is what makes 717 ppm trustworthy rather than a bug in
 * the measurement. Y3 is the faulty part.
 */

#include <stdlib.h>

#include <zephyr/kernel.h>
#include <zephyr/ztest.h>
#include <hal/nrf_clock.h>

#include "clock_measure.h"

ZTEST_SUITE(careloop_2_clocks, NULL, NULL, NULL, NULL, NULL);

/*
 * The sleep clock must be the crystal, not the RC oscillator. Running on RC
 * is not a failure the radio reports - it simply widens every receive window
 * until connections drop, and careloop_defconfig declares 20 ppm, which
 * the RC cannot come close to honouring.
 */
ZTEST(careloop_2_clocks, test_clock_lfclk_source)
{
    nrf_clock_lfclk_t src = NRF_CLOCK_LFCLK_RC;
    bool running = nrf_clock_is_running(NRF_CLOCK, NRF_CLOCK_DOMAIN_LFCLK, &src);

    printk("  LFCLK running=%d src=%s (LFCLKSTAT raw 0x%08x)\n",
           (int)running, clock_lfclk_src_name(src),
           (unsigned int)NRF_CLOCK->LFCLKSTAT);

    zassert_true(running, "LFCLK is not running");
    zassert_equal(src, NRF_CLOCK_LFCLK_XTAL,
                  "LFCLK source is %s, not XTAL - Y4 (32.768 kHz) did not "
                  "start and the SoC fell back to the internal RC",
                  clock_lfclk_src_name(src));
}

/*
 * HFXO must start, and must start quickly. This is the one test here that can
 * implicate Y3 on its own: the ratio test that follows cannot tell Y3 from Y4,
 * but a slow or failed HFXO start points squarely at the 32 MHz part or its
 * loading capacitors.
 */
ZTEST(careloop_2_clocks, test_clock_hfxo_starts)
{
    uint32_t us = clock_hfxo_start_us();
    nrf_clock_hfclk_t src = NRF_CLOCK_HFCLK_LOW_ACCURACY;

    zassert_not_equal(us, UINT32_MAX,
                      "HFXO did not start within %u ms - Y3 (32 MHz) is not "
                      "oscillating; the SoC is running on the internal RC and "
                      "the radio cannot work at all",
                      CLOCK_HFXO_START_TIMEOUT_MS);

    (void)nrf_clock_is_running(NRF_CLOCK, NRF_CLOCK_DOMAIN_HFCLK, &src);

    printk("  HFXO start %u us, src now %s (HFCLKSTAT raw 0x%08x)\n",
           (unsigned int)us,
           src == NRF_CLOCK_HFCLK_HIGH_ACCURACY ? "XTAL" : "RC",
           (unsigned int)NRF_CLOCK->HFCLKSTAT);

    zassert_equal(src, NRF_CLOCK_HFCLK_HIGH_ACCURACY,
                  "HFCLK reports RC after a successful HFXO start");
}

/*
 * The measurement that matters.
 *
 * Repeated over three gate lengths: a real frequency ratio is independent of
 * how long you look, while a measurement artefact is not. If all three agree,
 * the disagreement is physical.
 */
ZTEST(careloop_2_clocks, test_clock_lfxo_hfxo_ratio)
{
    static const uint32_t gates_ms[] = { 250U, 1000U, 2000U };
    int64_t ppm[ARRAY_SIZE(gates_ms)];
    uint32_t us;

    us = clock_hfxo_start_us();
    zassert_not_equal(us, UINT32_MAX, "HFXO did not start - cannot measure");

    for (size_t i = 0U; i < ARRAY_SIZE(gates_ms); i++) {
        uint32_t gate = (CLOCK_LF_TICKS_PER_SEC * gates_ms[i]) / 1000U;
        uint32_t counts = 0U, elapsed = 0U;

        ppm[i] = clock_measure_ratio_ppm(gate, &counts, &elapsed);

        printk("  gate %4u ms: %u LF ticks, %u HF counts -> %lld ppm\n",
               (unsigned int)gates_ms[i], (unsigned int)elapsed,
               (unsigned int)counts, (long long)ppm[i]);
    }

    /* Report before asserting: the numbers are the point of the test, and a
     * zassert that fires first would hide the other two gates.
     */
    zassert_true(llabs((long long)ppm[ARRAY_SIZE(gates_ms) - 1]) <= CLOCK_BLE_ACTIVE_PPM,
                 "LFXO and HFXO disagree by %lld ppm; Bluetooth allows +-%d ppm "
                 "on the active clock and this board declares 20 ppm sleep-clock "
                 "accuracy.\n"
                 "  One of the two crystals is off, and this measurement cannot "
                 "say which - it is a ratio.\n"
                 "  Y4 (32.768 kHz) is the less likely culprit: the entire "
                 "pulling range of a tuning-fork crystal is about 150 ppm, so "
                 "load capacitance alone cannot produce this.\n"
                 "  Y3 (32 MHz) can: at 2.44 GHz this error is about %lld kHz, "
                 "wider than the 2 MHz channel spacing, which would put the "
                 "carrier outside the channel in both directions - exactly the "
                 "symmetric radio failure observed.\n"
                 "  To settle it, compare against a part known to be right: run "
                 "this same suite on an nRF52840 DK, or put a counter on Y3.",
                 (long long)ppm[ARRAY_SIZE(gates_ms) - 1], CLOCK_BLE_ACTIVE_PPM,
                 (long long)(ppm[ARRAY_SIZE(gates_ms) - 1] * 2440000 / 1000000));
}

/*
 * What the controller tells the peer about its sleep clock. A declaration
 * tighter than the hardware can honour is worse than a loose one: the peer
 * sizes its receive windows from this number and will stop listening before
 * a drifting peripheral actually transmits.
 */
ZTEST(careloop_2_clocks, test_clock_declared_sca)
{
    printk("  declared sleep-clock accuracy: %s\n", clock_declared_sca());
    printk("  LF reference: %u Hz\n", (unsigned int)CLOCK_LF_TICKS_PER_SEC);

    zassert_equal(CLOCK_LF_TICKS_PER_SEC, 32768U,
                  "system clock is %u Hz, expected 32768 - the ratio "
                  "measurement assumes RTC1 on LFCLK",
                  (unsigned int)CLOCK_LF_TICKS_PER_SEC);
}
```

## src/test_hal_leds.c
```c
// SPDX-License-Identifier: Apache-2.0
// Copyright (c) 2026 CareLoop Labs

/*
 * hal/leds.h against the nPM1300's constant-current sinks (D4, D3, D2).
 *
 * Read this before trusting a green run, because most of what you want from an
 * LED test is not here and cannot be.
 *
 * Nothing in this file can see light. leds_set() returning 0 proves a register
 * reached U2 and nothing more. The anodes sit on +3V3, which reaches them only
 * through jumper J3 (JP_3V3), and BUCK2 senses its own output upstream of J3 -
 * so the PMIC reports the rail healthy whether or not that jumper is bridged.
 * That is not theoretical: the first board these ran against passed every check
 * here with all three LEDs dark, and bridging J3 fixed it.
 *
 * Do not try to close the loop with the fuel gauge. Two attempts died there.
 * SENSOR_CHAN_GAUGE_AVG_CURRENT decodes the raw IBAT code against a full scale
 * chosen from the charger's private ibat_stat, that status flaps between
 * consecutive samples, and the decoded idle current therefore jumps in exact
 * powers of two - measured across one session with nothing changing on the
 * board: -656, -3503, -7006, -14013, -28027 uA. Averaging idle readings either
 * side of a lit LED does not rescue it; it turns the drift into a delta and
 * reports a confident pass on a dark board.
 *
 * What this suite does not prove:
 *   - that any light is emitted;
 *   - that channel n is the LED silkscreened D4/D3/D2 - swapped D3 and D2 pass;
 *   - that leds_set_mask() maps bit n to channel n, which is the only real
 *     logic in src/hal/leds_npm1300.c and is checked by nothing, anywhere;
 *   - that J3 is bridged, or +3V3 is present at the anodes;
 *   - that a part is populated, or fitted the right way round.
 *
 * All of that needs a person looking at the board:
 *   ./scripts/bringup.sh LEDs
 * which drives these same HAL entry points slowly enough to follow. Test 60
 * below is a deliberate skip so that gap appears in the Twister report rather
 * than only in this comment.
 *
 * Runs last of the HAL suites, and leaves every sink off.
 */

#include <zephyr/kernel.h>
#include <zephyr/ztest.h>
#include <zephyr/sys/util.h>

#include <leds.h>

/* Long enough for an eye, short enough not to pad the suite. */
#define LED_DWELL_MS 150U

/* Channel index is the PMIC's LED number; the designator is what is silkscreened. */
static const char *const led_ref[LEDS_COUNT] = { "D4", "D3", "D2" };

ZTEST_SUITE(careloop_hal_4_leds, NULL, NULL, NULL, NULL, NULL);

ZTEST(careloop_hal_4_leds, test_hal_leds_10_init)
{
    /*
     * Also proves the sinks were actively cleared. The led_npm13xx driver's own
     * init writes the three mode registers and stops - it never touches
     * LEDSET/LEDCLR - so a sink left on by the previous image survives a warm
     * reset unless leds_init() clears it.
     */
    zassert_ok(leds_init(),
               "leds_init() failed - U2's LED register interface is "
               "unreachable. careloop_3_i2c's bus scan is the place to look");
}

ZTEST(careloop_hal_4_leds, test_hal_leds_20_bounds_and_geometry)
{
    /*
     * The only assertions in this file with real teeth: pure API contract, no
     * hardware dependency, and they fail if the board definition changes under
     * the HAL rather than silently driving the wrong number of sinks.
     */
    zassert_equal(LEDS_COUNT, 3U,
                  "the nPM1300 has exactly three sinks; LEDS_COUNT is %u",
                  LEDS_COUNT);
    zassert_equal(LEDS_MASK_ALL, 0x07U,
                  "LEDS_MASK_ALL must cover exactly LEDS_COUNT channels");

    zassert_equal(leds_set(LEDS_COUNT, true), -ERR_LEDS_INVALID_CHANNEL,
                  "channel %u was accepted on a three-channel controller",
                  LEDS_COUNT);
    zassert_equal(leds_set(255U, true), -ERR_LEDS_INVALID_CHANNEL,
                  "channel 255 was accepted");

    zassert_equal(leds_set_mask(LEDS_MASK_ALL | BIT(LEDS_COUNT)),
                  -ERR_LEDS_INVALID_CHANNEL,
                  "a mask with a bit above LEDS_COUNT was accepted");
    zassert_equal(leds_set_mask(0xFFU), -ERR_LEDS_INVALID_CHANNEL,
                  "an all-ones mask was accepted");
}

ZTEST(careloop_hal_4_leds, test_hal_leds_30_walk)
{
    /* For the operator, not for ztest - and only if someone is looking. */
    for (uint8_t ch = 0U; ch < LEDS_COUNT; ch++) {
        int rc = leds_set(ch, true);

        zassert_ok(rc, "leds_set(%u, true) for %s failed (%d)%s", ch,
                   led_ref[ch], rc,
                   rc == -ERR_LEDS_NOT_CONTROLLABLE
                       ? " - sink not in host mode, check nordic,ledN-mode in "
                         "careloop.dts"
                       : "");

        printk("  led%u (%s) on\n", ch, led_ref[ch]);
        k_sleep(K_MSEC(LED_DWELL_MS));

        zassert_ok(leds_set(ch, false), "leds_set(%u, false) for %s failed", ch,
                   led_ref[ch]);
    }
}

ZTEST(careloop_hal_4_leds, test_hal_leds_40_mask_walk)
{
    static const uint8_t patterns[] = { 0x01U, 0x02U, 0x04U, 0x07U, 0x00U };

    /*
     * leds_set_mask()'s bit-to-channel loop is the only real logic in the HAL's
     * LED path, and nothing here can check it: a mask that walks the LEDs
     * backwards passes every assertion below. Only the operator running
     * ./scripts/bringup.sh LEDs can tell.
     */
    for (size_t i = 0U; i < ARRAY_SIZE(patterns); i++) {
        zassert_ok(leds_set_mask(patterns[i]),
                   "leds_set_mask(0x%02x) failed", patterns[i]);

        printk("  mask 0x%02x\n", patterns[i]);
        k_sleep(K_MSEC(LED_DWELL_MS));
    }
}

ZTEST(careloop_hal_4_leds, test_hal_leds_50_mask_is_whole_state)
{
    /*
     * A clear bit means off, not "leave alone". Return codes only - whether
     * channels 1 and 2 actually went dark is unobservable from here.
     */
    zassert_ok(leds_set_mask(LEDS_MASK_ALL), "leds_set_mask(ALL) failed");
    k_sleep(K_MSEC(LED_DWELL_MS));

    zassert_ok(leds_set_mask(BIT(0)), "leds_set_mask(BIT(0)) failed");
    k_sleep(K_MSEC(LED_DWELL_MS));

    zassert_ok(leds_set_mask(0U), "leds_set_mask(0) failed");
}

ZTEST(careloop_hal_4_leds, test_hal_leds_60_visual_check_is_manual)
{
    printk("  no firmware check can see light on this board\n");
    printk("  run ./scripts/bringup.sh LEDs and watch D4, D3, D2\n");
    printk("  if nothing lights, check jumper J3 (JP_3V3) before the LEDs\n");

    /*
     * Skipped rather than passed, so the gap shows up in the Twister report
     * where somebody reading a green run will see it.
     */
    ztest_test_skip();
}

ZTEST(careloop_hal_4_leds, test_hal_leds_70_leaves_all_off)
{
    zassert_ok(leds_set_mask(0U),
               "failed to turn the LEDs off at the end of the suite");

    printk("  all sinks off\n");
}
```

## src/test_hal_motion.c
```c
// SPDX-License-Identifier: Apache-2.0
// Copyright (c) 2026 CareLoop Labs

/*
 * hal/motion.h against the BMI270 (U4).
 *
 * Layers on careloop_5_imu, which proves U4 answers and reports gravity through
 * the Zephyr driver. This suite proves the shipping wrapper configures, paces
 * and converts correctly. The gravity check is duplicated on purpose: the two
 * reach it by different paths, and a failure here with careloop_5_imu green
 * means src/hal/motion_bmi270.c.
 *
 * Read this before interpreting a NOT_CONFIGURED result. careloop_5_imu ran
 * first and set ODR 100 Hz / 8 g on the chip directly, behind the HAL's back,
 * and left the accelerometer powered. So NOT_CONFIGURED here reflects the HAL's
 * own bookkeeping, not an idle sensor - the chip may well be sampling.
 *
 * Two cases are one-shot for the life of the image and their order is fixed by
 * the digit in the case name, which is what ztest sorts on:
 *
 *   _30_ must precede _40_  - once any configure succeeds, "configured" latches
 *   _b0_ must precede _c0_  - once any-motion is configured, that latches too
 *
 * Neither HAL exposes a way back, so a rename that reorders them silently
 * deletes the coverage. The digits are load-bearing, not decorative.
 *
 * What this does not prove:
 *   - the gyroscope scale factor. Every gyro assertion here is taken at rest,
 *     so it is a bias check. A factor-of-two error in the rad-to-mdps
 *     conversion, or a wrong SENSOR_PI, passes untouched. That needs a
 *     controlled rotation rate, which this bench does not have.
 *   - the effective ODR after snapping. motion_configure() snaps a request down
 *     to the sensor's ladder but the HAL exposes no getter for the result, so
 *     test 50 checks only that the request was accepted.
 *   - that any-motion fires. See test f0.
 */

#include <zephyr/kernel.h>
#include <zephyr/ztest.h>
#include <zephyr/sys/atomic.h>
#include <zephyr/sys/util.h>

#include <motion.h>

/* Bench limits. Gravity is 9807 mm/s^2; allow for tilt, noise and offset. */
#define ACCEL_MAGNITUDE_TOLERANCE_MMS2 2500

/* A still board should not exceed this on any gyro axis. 20 dps is generous. */
#define GYRO_REST_MAX_MDPS 20000

#define ACCEL_ODR_MHZ 100000U
#define ACCEL_RANGE_G 8U
#define GYRO_ODR_MHZ 100000U
#define GYRO_RANGE_DPS 250U

/* 100 Hz puts the accel in performance mode, where only OSR 1/2/4 are legal. */
#define ACCEL_OSR 1U

#define MOTION_SETTLE_MS 50U
#define GYRO_SETTLE_MS 100U
#define DATA_READY_WINDOW_MS 200U

/*
 * Any-motion limits, from the part rather than from the vendor driver.
 *
 * The duration ceiling used to be 81900 ms here, which was the driver's
 * twelve-bit mask rather than the hardware: ANYMO_1.duration is thirteen bits
 * at 20 ms per step, so 8191 * 20 ms = 163820 ms, and the datasheet quotes
 * the range as 0 to 163 seconds. The HAL writes the register directly now and
 * so reaches all of it.
 */
#define ANY_MOTION_THRESHOLD_MIN_MG 1U
#define ANY_MOTION_THRESHOLD_MAX_MG 1000U
#define ANY_MOTION_DURATION_MAX_MS 163820U
#define ANY_MOTION_DURATION_STEP_MS 20U

static const struct motion_config running_config = {
    .accel_odr_mhz = ACCEL_ODR_MHZ,
    .accel_range_g = ACCEL_RANGE_G,
    .accel_oversampling = ACCEL_OSR,
    .gyro_odr_mhz = GYRO_ODR_MHZ,
    .gyro_range_dps = GYRO_RANGE_DPS,
};

static atomic_t data_ready_events;

/*
 * Runs on the system workqueue, shared with every other sensor on the board.
 * Counting is all it may do - no I2C, no printk, no blocking.
 */
static void motion_callback(enum motion_event event)
{
    if (event == MOTION_EVENT_DATA_READY) {
        atomic_inc(&data_ready_events);
    }
}

/*
 * Integer square root. Deliberately not sqrt() from libm: this file is built
 * with -Wdouble-promotion, and a vector length in mm/s^2 has no business
 * dragging floating point into a test image.
 *
 * Worst case here is three axes at 16 g full scale, about 7.4e10, so the
 * starting bit has to be a power of four above that - 4^19 is 2.7e11.
 */
static int32_t isqrt64(int64_t value)
{
    int64_t bit = 1LL << 38;
    int64_t root = 0;

    while (bit > value) {
        bit >>= 2;
    }

    while (bit != 0) {
        if (value >= root + bit) {
            value -= root + bit;
            root = (root >> 1) + bit;
        } else {
            root >>= 1;
        }
        bit >>= 2;
    }

    return (int32_t)root;
}

static int32_t accel_magnitude_mms2(const struct motion_accel_sample *sample)
{
    int64_t sum = ((int64_t)sample->x_mms2 * sample->x_mms2) +
                  ((int64_t)sample->y_mms2 * sample->y_mms2) +
                  ((int64_t)sample->z_mms2 * sample->z_mms2);

    return isqrt64(sum);
}

ZTEST_SUITE(careloop_hal_2_motion, NULL, NULL, NULL, NULL, NULL);

ZTEST(careloop_hal_2_motion, test_hal_motion_10_init)
{
    struct motion_fault fault;

    zassert_ok(motion_init(),
               "motion_init() failed - U4 did not answer at 0x68, the chip ID "
               "did not match, or the driver's config upload failed");

    /*
     * The earliest point the sensor's own health can be read: nothing has
     * configured or suspended anything yet. Printed rather than asserted
     * because the assertion belongs to careloop_hal_3_motion_fifo - what this
     * line is for is saying whether a fault seen later was already here,
     * which is the difference between a part that came up unhealthy and one
     * this firmware upset.
     */
    if (motion_get_fault(&fault) == 0) {
        printk("  fault at init   ERR_REG 0x%02x  INTERNAL_ERROR 0x%02x  feat_eng_disabled %d\n",
               fault.raw, fault.internal_raw, fault.feature_engine_disabled);
    }
}

ZTEST(careloop_hal_2_motion, test_hal_motion_20_capabilities)
{
    uint32_t caps = motion_get_capabilities();

    printk("  capabilities 0x%02x: gyro %s, oversampling %s, data-ready %s, "
           "any-motion %s\n", caps,
           (caps & MOTION_CAP_GYRO) ? "yes" : "no",
           (caps & MOTION_CAP_OVERSAMPLING) ? "yes" : "no",
           (caps & MOTION_CAP_DATA_READY) ? "yes" : "no",
           (caps & MOTION_CAP_ANY_MOTION) ? "yes" : "no");

    zassert_true(caps & MOTION_CAP_GYRO, "the BMI270 has a gyroscope");
    zassert_true(caps & MOTION_CAP_OVERSAMPLING,
                 "the BMI270 supports oversampling");

    /*
     * The config-parity tripwire. These two are compiled out unless
     * CONFIG_BMI270_TRIGGER is on, so without them this suite would be
     * verifying a HAL built differently from the one the product ships.
     */
    zassert_true(caps & MOTION_CAP_DATA_READY,
                 "no data-ready capability - CONFIG_BMI270_TRIGGER_GLOBAL_THREAD "
                 "is missing from prj.conf, or careloop.dts lost irq-gpios "
                 "index 1 (INT2)");
    zassert_true(caps & MOTION_CAP_ANY_MOTION,
                 "no any-motion capability - needs "
                 "CONFIG_BMI270_TRIGGER_GLOBAL_THREAD, irq-gpios index 0 "
                 "(INT1), and the \"bosch,bmi270-base\" compatible in "
                 "careloop.dts");
}

ZTEST(careloop_hal_2_motion, test_hal_motion_30_read_before_configure)
{
    struct motion_accel_sample accel;
    struct motion_gyro_sample gyro;

    /*
     * One-shot: must run before test 40, which is the first case that gets a
     * configure accepted - after that "configured" latches for the life of the
     * image. U4 is very likely sampling right now, left running by
     * careloop_5_imu; what this pins is that the HAL refuses to report a sample
     * it did not ask for.
     */
    zassert_equal(motion_read_accel(&accel), -ERR_MOTION_NOT_CONFIGURED,
                  "reading before configuring must fail");
    zassert_equal(motion_read_gyro(&gyro), -ERR_MOTION_NOT_CONFIGURED,
                  "reading before configuring must fail");
    zassert_equal(motion_set_enabled(true), -ERR_MOTION_NOT_CONFIGURED,
                  "enabling before configuring must fail - there is no rate to "
                  "enable at");
}

ZTEST(careloop_hal_2_motion, test_hal_motion_40_invalid_config_rejected)
{
    /* static const: nine of these would be a lot of ztest thread stack. */
    static const struct motion_config rejected[] = {
        /* Ranges must match the ladder exactly; rounding changes resolution. */
        { .accel_odr_mhz = ACCEL_ODR_MHZ, .accel_range_g = 3U },
        { .accel_odr_mhz = ACCEL_ODR_MHZ, .accel_range_g = 0U },
        /* Below the slowest accel rung (782 mHz) - must fail, not power down. */
        { .accel_odr_mhz = 100U, .accel_range_g = ACCEL_RANGE_G },
        { .gyro_odr_mhz = GYRO_ODR_MHZ, .gyro_range_dps = 300U },
        /* Below the slowest gyro rung (25000 mHz). */
        { .gyro_odr_mhz = 1000U, .gyro_range_dps = GYRO_RANGE_DPS },
        /* OSR 8 is illegal at 200 Hz: performance mode allows only 1/2/4. */
        { .accel_odr_mhz = 200000U, .accel_range_g = ACCEL_RANGE_G,
          .accel_oversampling = 8U },
        { .gyro_odr_mhz = GYRO_ODR_MHZ, .gyro_range_dps = GYRO_RANGE_DPS,
          .gyro_oversampling = 8U },
    };
    struct motion_accel_sample accel;

    for (size_t i = 0U; i < ARRAY_SIZE(rejected); i++) {
        zassert_equal(motion_configure(&rejected[i]),
                      -ERR_MOTION_INVALID_CONFIG,
                      "config %u was accepted: accel %u mHz / %u g / osr %u, "
                      "gyro %u mHz / %u dps / osr %u", i,
                      rejected[i].accel_odr_mhz, rejected[i].accel_range_g,
                      rejected[i].accel_oversampling, rejected[i].gyro_odr_mhz,
                      rejected[i].gyro_range_dps, rejected[i].gyro_oversampling);
    }

    zassert_equal(motion_configure(NULL), -ERR_MOTION_INVALID_CONFIG,
                  "a NULL config was accepted");

    /*
     * The same OSR of 8 that was rejected at 200 Hz is legal below 100 Hz,
     * where the accelerometer leaves performance mode and the driver switches
     * lookup tables. This pair is what pins that the validation is rate-aware
     * rather than a fixed list.
     */
    {
        const struct motion_config slow_osr8 = {
            .accel_odr_mhz = 50000U,
            .accel_range_g = ACCEL_RANGE_G,
            .accel_oversampling = 8U,
        };

        zassert_ok(motion_configure(&slow_osr8),
                   "oversampling 8 must be accepted at 50 Hz even though it is "
                   "rejected at 200 Hz");
    }

    /*
     * Every rejection above must have left no half-written state. The HAL
     * validates the whole config before it writes anything, so a rejected
     * request must not have disturbed the accepted one.
     */
    zassert_ok(motion_read_accel(&accel),
               "the accepted 50 Hz config did not take effect, so a rejected "
               "config left the HAL in a half-configured state");
}

ZTEST(careloop_hal_2_motion, test_hal_motion_50_configure_snaps_odr)
{
    struct motion_config between = running_config;

    /* 150 Hz sits between the 100 Hz and 200 Hz rungs; it snaps down to 100. */
    between.accel_odr_mhz = 150000U;
    zassert_ok(motion_configure(&between),
               "a rate between two ladder rungs must snap down, not fail");

    /* 60 Hz sits between 50 and 100. */
    between.accel_odr_mhz = 60000U;
    zassert_ok(motion_configure(&between),
               "60 Hz must snap down to the 50 Hz rung");

    /*
     * Only the return code is checked. The HAL exposes no getter for the
     * effective rate, so the snapped value is observable solely by measuring
     * the sample rate - which this suite does not do.
     */
}

ZTEST(careloop_hal_2_motion, test_hal_motion_60_accel_is_gravity)
{
    struct motion_accel_sample accel;
    int32_t magnitude;

    zassert_ok(motion_configure(&running_config), "configure failed");
    k_sleep(K_MSEC(MOTION_SETTLE_MS));

    zassert_ok(motion_read_accel(&accel), "motion_read_accel() failed");

    magnitude = accel_magnitude_mms2(&accel);

    printk("  accel %d, %d, %d mm/s^2, magnitude %d\n", accel.x_mms2,
           accel.y_mms2, accel.z_mms2, magnitude);

    /*
     * Magnitude rather than per-axis, and deliberately so: a dead or stuck axis
     * still reads plausibly on its own, and only the vector length catches it.
     * A magnitude near zero means the accelerometer is powered down.
     */
    zassert_between_inclusive(magnitude,
                              MOTION_GRAVITY_MMS2 - ACCEL_MAGNITUDE_TOLERANCE_MMS2,
                              MOTION_GRAVITY_MMS2 + ACCEL_MAGNITUDE_TOLERANCE_MMS2,
                              "acceleration magnitude %d mm/s^2 is not gravity "
                              "(%d) - is U4 powered, and is the board still?",
                              magnitude, MOTION_GRAVITY_MMS2);
}

ZTEST(careloop_hal_2_motion, test_hal_motion_70_gyro_near_zero_at_rest)
{
    struct motion_gyro_sample gyro;

    zassert_ok(motion_configure(&running_config), "configure failed");
    k_sleep(K_MSEC(GYRO_SETTLE_MS));

    zassert_ok(motion_read_gyro(&gyro), "motion_read_gyro() failed");

    printk("  gyro %d, %d, %d mdps\n", gyro.x_mdps, gyro.y_mdps, gyro.z_mdps);

    /*
     * A bias check, not a scale check. A wrong radians-to-millidegrees factor
     * passes this untouched, because zero times anything is zero.
     */
    zassert_between_inclusive(gyro.x_mdps, -GYRO_REST_MAX_MDPS,
                              GYRO_REST_MAX_MDPS,
                              "gyro X %d mdps at rest", gyro.x_mdps);
    zassert_between_inclusive(gyro.y_mdps, -GYRO_REST_MAX_MDPS,
                              GYRO_REST_MAX_MDPS,
                              "gyro Y %d mdps at rest", gyro.y_mdps);
    zassert_between_inclusive(gyro.z_mdps, -GYRO_REST_MAX_MDPS,
                              GYRO_REST_MAX_MDPS,
                              "gyro Z %d mdps at rest", gyro.z_mdps);
}

ZTEST(careloop_hal_2_motion, test_hal_motion_80_suspend_and_resume)
{
    struct motion_accel_sample accel;
    int32_t magnitude;

    zassert_ok(motion_configure(&running_config), "configure failed");
    k_sleep(K_MSEC(MOTION_SETTLE_MS));

    zassert_ok(motion_set_enabled(false), "suspend failed");

    zassert_equal(motion_read_accel(&accel), -ERR_MOTION_NOT_CONFIGURED,
                  "a read while suspended must fail rather than return the last "
                  "live sample");

    /* Idempotent: the HAL returns early when the state already matches. */
    zassert_ok(motion_set_enabled(false), "a redundant suspend must succeed");

    zassert_ok(motion_set_enabled(true), "resume failed");
    k_sleep(K_MSEC(MOTION_SETTLE_MS));

    zassert_ok(motion_read_accel(&accel), "read after resume failed");
    magnitude = accel_magnitude_mms2(&accel);

    printk("  magnitude after resume %d mm/s^2\n", magnitude);

    /*
     * Suspend works by writing a rate of 0, which clears PWR_CTRL. If resume
     * only flipped a flag and never restored the rate, the sensor stays powered
     * down and this reads near zero - which is exactly what that failure looks
     * like.
     */
    zassert_between_inclusive(magnitude,
                              MOTION_GRAVITY_MMS2 - ACCEL_MAGNITUDE_TOLERANCE_MMS2,
                              MOTION_GRAVITY_MMS2 + ACCEL_MAGNITUDE_TOLERANCE_MMS2,
                              "magnitude %d mm/s^2 after resume - a value near "
                              "zero means resume did not re-power the MEMS",
                              magnitude);
}

ZTEST(careloop_hal_2_motion, test_hal_motion_90_gyro_odr_zero)
{
    struct motion_config accel_only = running_config;
    struct motion_accel_sample accel;
    struct motion_gyro_sample gyro;

    accel_only.gyro_odr_mhz = 0U;

    zassert_ok(motion_configure(&accel_only),
               "a zero gyro rate must be accepted - it means leave the gyro "
               "powered down");
    k_sleep(K_MSEC(MOTION_SETTLE_MS));

    /* NOT_CONFIGURED is per axis, not for the whole device. */
    zassert_equal(motion_read_gyro(&gyro), -ERR_MOTION_NOT_CONFIGURED,
                  "the gyro is powered down, so reading it must fail");
    zassert_ok(motion_read_accel(&accel),
               "the accelerometer is still configured and must still read");

    /* Put the gyro back for the cases that follow. */
    zassert_ok(motion_configure(&running_config), "reconfigure failed");
}

ZTEST(careloop_hal_2_motion, test_hal_motion_a0_any_motion_limits)
{
    struct motion_any_motion_limits limits;

    zassert_ok(motion_get_any_motion_limits(&limits),
               "any-motion limits must be readable once initialised");

    printk("  any-motion threshold %u..%u mg, duration max %u ms step %u ms\n",
           limits.threshold_min_mg, limits.threshold_max_mg,
           limits.duration_max_ms, limits.duration_step_ms);

    /*
     * These are re-derived driver internals, pinned against NCS v3.4.0. If they
     * change after an SDK bump the answer is to re-derive them from the driver,
     * not to relax the test - a caller that clamps to the wrong limits arms the
     * sensor at a threshold it did not intend.
     */
    zassert_equal(limits.threshold_min_mg, ANY_MOTION_THRESHOLD_MIN_MG,
                  "threshold floor changed");
    zassert_equal(limits.threshold_max_mg, ANY_MOTION_THRESHOLD_MAX_MG,
                  "threshold ceiling changed");
    zassert_equal(limits.duration_max_ms, ANY_MOTION_DURATION_MAX_MS,
                  "duration ceiling changed - the register field is 12 bits at "
                  "20 ms per LSB, and a larger value overflows into the "
                  "axis-select bits");
    zassert_equal(limits.duration_step_ms, ANY_MOTION_DURATION_STEP_MS,
                  "duration granularity changed");

    /* No INVALID_ARG code exists for this entry point; NULL is UNSUPPORTED. */
    zassert_equal(motion_get_any_motion_limits(NULL), -ERR_MOTION_UNSUPPORTED,
                  "NULL is reported as UNSUPPORTED by contract");
}

ZTEST(careloop_hal_2_motion, test_hal_motion_b0_enable_before_configure)
{
    /*
     * One-shot: must run before test c0, which latches any_motion_configured
     * for the rest of the image. Arming against thresholds that were never
     * written either floods the callback or never fires, and neither is
     * distinguishable from working hardware - so the HAL refuses.
     */
    zassert_equal(motion_set_event_enabled(MOTION_EVENT_ANY_MOTION, true),
                  -ERR_MOTION_NOT_CONFIGURED,
                  "arming any-motion before configuring its thresholds must "
                  "fail - the thresholds only reach the chip through the "
                  "trigger_set() the driver performs on arming");
}

ZTEST(careloop_hal_2_motion, test_hal_motion_c0_any_motion_bounds)
{
    static const struct motion_any_motion_config rejected[] = {
        { .threshold_mg = 0U, .duration_ms = 100U },
        { .threshold_mg = ANY_MOTION_THRESHOLD_MAX_MG + 1U, .duration_ms = 100U },
        { .threshold_mg = 100U, .duration_ms = ANY_MOTION_DURATION_MAX_MS + 1U },
    };
    /* Boundaries the HAL must accept; the max takes the full-scale branch. */
    static const struct motion_any_motion_config accepted[] = {
        { .threshold_mg = ANY_MOTION_THRESHOLD_MIN_MG, .duration_ms = 100U },
        { .threshold_mg = ANY_MOTION_THRESHOLD_MAX_MG, .duration_ms = 100U },
        /* 30 ms is not a multiple of the 20 ms step; it rounds down. */
        { .threshold_mg = 100U, .duration_ms = 30U },
    };

    /* Out-of-range requests are rejected, never silently clamped. */
    for (size_t i = 0U; i < ARRAY_SIZE(rejected); i++) {
        zassert_equal(motion_configure_any_motion(&rejected[i]),
                      -ERR_MOTION_INVALID_CONFIG,
                      "any-motion config %u was accepted: %u mg, %u ms", i,
                      rejected[i].threshold_mg, rejected[i].duration_ms);
    }

    zassert_equal(motion_configure_any_motion(NULL),
                  -ERR_MOTION_INVALID_CONFIG, "a NULL config was accepted");

    for (size_t i = 0U; i < ARRAY_SIZE(accepted); i++) {
        zassert_ok(motion_configure_any_motion(&accepted[i]),
                   "any-motion config %u was rejected: %u mg, %u ms", i,
                   accepted[i].threshold_mg, accepted[i].duration_ms);
    }
}

ZTEST(careloop_hal_2_motion, test_hal_motion_d0_callback_and_enable)
{
    zassert_ok(motion_set_event_callback(motion_callback),
               "setting the event callback failed");

    zassert_ok(motion_set_event_enabled(MOTION_EVENT_DATA_READY, true),
               "arming data-ready failed - INT2 is P0.09");
    zassert_ok(motion_set_event_enabled(MOTION_EVENT_ANY_MOTION, true),
               "arming any-motion failed - INT1 is P1.15");

    zassert_ok(motion_set_event_enabled(MOTION_EVENT_ANY_MOTION, false),
               "disarming any-motion failed");
    zassert_ok(motion_set_event_enabled(MOTION_EVENT_DATA_READY, false),
               "disarming data-ready failed");
}

ZTEST(careloop_hal_2_motion, test_hal_motion_e0_data_ready_fires)
{
    atomic_val_t seen;

    zassert_ok(motion_configure(&running_config), "configure failed");
    zassert_ok(motion_set_event_callback(motion_callback), "callback failed");

    atomic_clear(&data_ready_events);

    zassert_ok(motion_set_event_enabled(MOTION_EVENT_DATA_READY, true),
               "arming data-ready failed");

    k_sleep(K_MSEC(DATA_READY_WINDOW_MS));

    seen = atomic_get(&data_ready_events);
    zassert_ok(motion_set_event_enabled(MOTION_EVENT_DATA_READY, false),
               "disarming data-ready failed");

    printk("  %d data-ready events in %u ms at 100 Hz\n", (int)seen,
           DATA_READY_WINDOW_MS);

    /*
     * The only firmware-observable proof that the INT2 line physically works -
     * everything else in this suite would pass with both interrupt pins
     * unconnected.
     */
    zassert_true(seen > 0,
                 "no data-ready interrupt in %u ms with the accelerometer at "
                 "100 Hz. INT2 is P0.09, an NFC pin: it is GPIO only if "
                 "nfct-pins-as-gpios in careloop.dts actually reached UICR, "
                 "which needs a full erase and a power cycle. Check "
                 "0x1000120C reads 0xFFFFFFFE. Both interrupt pins are marked "
                 "unverified in the dts", DATA_READY_WINDOW_MS);
}

ZTEST(careloop_hal_2_motion, test_hal_motion_f0_any_motion_is_manual)
{
    const struct motion_any_motion_config sensitive = {
        .threshold_mg = ANY_MOTION_THRESHOLD_MIN_MG,
        .duration_ms = ANY_MOTION_DURATION_STEP_MS,
    };

    zassert_ok(motion_configure_any_motion(&sensitive),
               "arming any-motion at its most sensitive setting failed");

    printk("  any-motion armed at %u mg / %u ms\n", sensitive.threshold_mg,
           sensitive.duration_ms);
    printk("  firing it needs the board picked up - not assertable here\n");

    /*
     * Waiting for ambient bench vibration to cross a 1 mg threshold is a coin
     * flip, and a flaky hardware test is worse than an honest gap. Skipped so
     * the gap lands in the Twister report rather than only in this comment.
     */
    ztest_test_skip();
}
```

## src/test_i2c.c
```c
// SPDX-License-Identifier: Apache-2.0
// Copyright (c) 2026 CareLoop Labs

/*
 * Shared I2C bus and device presence.
 *
 * Runs before any driver-level suite so that a bus fault is reported once,
 * as a bus fault, instead of as three unrelated sensor failures. The `3` in
 * the suite name is what enforces that - suites run in alphabetical order, not
 * link order - so it has to stay below the sensor suites' digits. See main.c.
 *
 * Each device is probed repeatedly rather than once. A single probe would
 * have passed a board that was intermittently dropping the TMP117, which is
 * exactly the defect this suite exists to catch.
 */

#include <zephyr/kernel.h>
#include <zephyr/ztest.h>
#include <zephyr/device.h>
#include <zephyr/drivers/i2c.h>

#define ADDR_TMP117  0x48U
#define ADDR_BMI270  0x68U
#define ADDR_NPM1300 0x6bU

#define PRESENCE_PROBES 64U

/*
 * Valid 7-bit range for the sweep. 0x00-0x07 and 0x78-0x7f are reserved by
 * the I2C spec and must not be probed - some parts misbehave when addressed
 * there.
 */
#define ADDR_FIRST 0x08U
#define ADDR_LAST  0x77U

static const struct device *const i2c = DEVICE_DT_GET(DT_NODELABEL(i2c0));

static const struct {
    uint8_t     addr;
    const char *name;
} expected[] = {
    { ADDR_TMP117,  "tmp117"  },
    { ADDR_BMI270,  "bmi270"  },
    { ADDR_NPM1300, "npm1300" },
};

ZTEST_SUITE(careloop_3_i2c, NULL, NULL, NULL, NULL, NULL);

/* Zero-length write: addresses the device and checks only the ACK. */
static bool probe_once(uint8_t addr)
{
    uint8_t dummy = 0U;

    return i2c_write(i2c, &dummy, 0U, addr) == 0;
}

static void assert_present(uint8_t addr, const char *name)
{
    uint32_t fails = 0U;

    for (uint32_t i = 0U; i < PRESENCE_PROBES; i++) {
        if (!probe_once(addr)) {
            fails++;
        }
    }

    printk("  %-8s 0x%02x  %u/%u ACK\n", name, addr,
           PRESENCE_PROBES - fails, PRESENCE_PROBES);

    zassert_equal(fails, 0U, "%s at 0x%02x missed %u of %u probes",
                  name, addr, fails, PRESENCE_PROBES);
}

ZTEST(careloop_3_i2c, test_i2c_bus_ready)
{
    zassert_true(device_is_ready(i2c), "i2c0 not ready");
}

ZTEST(careloop_3_i2c, test_i2c_tmp117_present)
{
    assert_present(ADDR_TMP117, "tmp117");
}

ZTEST(careloop_3_i2c, test_i2c_bmi270_present)
{
    assert_present(ADDR_BMI270, "bmi270");
}

ZTEST(careloop_3_i2c, test_i2c_npm1300_present)
{
    assert_present(ADDR_NPM1300, "npm1300");
}

/*
 * Full sweep of the address space.
 *
 * The three tests above ask "is the part I expect still answering?"; this one
 * asks "what else is out there?" and is the only check that can see a device
 * nobody declared - a stray part, a wrong stuff option, or a footprint fitted
 * with something other than the BOM says.
 *
 * It asserts almost nothing on purpose. Presence of the three known devices is
 * already covered above with 64 probes each, which is the stronger test; a
 * second single-probe assertion here would only add a flaky duplicate. The
 * count check exists so that a completely floating bus - every address NAKing,
 * which is what a wrong pin assignment looks like - still fails loudly rather
 * than printing an empty map and passing.
 *
 * This replaces the standalone test/bringup/i2cscan app, whose other job was
 * finding which pins the bus is on. That is settled: SDA P1.02, SCL P1.04, in
 * boards/careloop/careloop_nrf52840_2_0_0.overlay.
 */
ZTEST(careloop_3_i2c, test_i2c_bus_scan)
{
    uint32_t found = 0U;

    printk("  scanning 0x%02x-0x%02x\n", ADDR_FIRST, ADDR_LAST);

    for (uint8_t addr = ADDR_FIRST; addr <= ADDR_LAST; addr++) {
        const char *name = "UNEXPECTED";

        if (!probe_once(addr)) {
            continue;
        }

        found++;

        for (size_t i = 0U; i < ARRAY_SIZE(expected); i++) {
            if (expected[i].addr == addr) {
                name = expected[i].name;
                break;
            }
        }

        printk("    ACK 0x%02x  %s\n", addr, name);
    }

    printk("  %u device(s) on the bus\n", found);

    zassert_true(found >= ARRAY_SIZE(expected),
                 "only %u device(s) ACKed across 0x%02x-0x%02x, expected at "
                 "least %u - a bus where nothing answers is what a wrong pin "
                 "assignment or a missing pull-up looks like",
                 found, ADDR_FIRST, ADDR_LAST, (unsigned int)ARRAY_SIZE(expected));
}
```

## src/test_power.c
```c
// SPDX-License-Identifier: Apache-2.0
// Copyright (c) 2026 CareLoop Labs

/*
 * nPM1300 PMIC (U2) - every rail on the board comes from here.
 *
 * Note what the readiness check does and does not prove. The MCU is only
 * executing because BUCK1 is already up, so this cannot fail "because the
 * PMIC is dead" - it fails when the register interface is unreachable.
 *
 * Battery voltage comes from the PMIC's own VBAT ADC. There is no resistor
 * divider into a SAADC pin anywhere on this board, so this is the only
 * measurement available.
 *
 * Jig requirement: a cell must be fitted or VBAT driven from a supply.
 * A board powered only over USB with no cell reads near zero and fails
 * here correctly but confusingly.
 */

#include <zephyr/kernel.h>
#include <zephyr/ztest.h>
#include <zephyr/device.h>
#include <zephyr/drivers/sensor.h>

#define DIE_TEMP_MIN_MC (-10000)
#define DIE_TEMP_MAX_MC 85000

#define VBAT_MIN_MV 3000
#define VBAT_MAX_MV 4400

static const struct device *const pmic =
    DEVICE_DT_GET(DT_NODELABEL(npm1300));
static const struct device *const charger =
    DEVICE_DT_GET(DT_NODELABEL(npm1300_charger));

ZTEST_SUITE(careloop_6_power, NULL, NULL, NULL, NULL, NULL);

ZTEST(careloop_6_power, test_power_pmic_ready)
{
    zassert_true(device_is_ready(pmic), "nPM1300 MFD not ready");
    zassert_true(device_is_ready(charger), "nPM1300 charger not ready");
}

ZTEST(careloop_6_power, test_power_die_temp_sane)
{
    struct sensor_value val;
    int32_t mc;

    zassert_ok(sensor_sample_fetch(charger), "charger sample fetch failed");
    zassert_ok(sensor_channel_get(charger, SENSOR_CHAN_DIE_TEMP, &val),
               "charger die temp read failed");

    mc = sensor_value_to_milli(&val);
    printk("  pmic die %d.%03d C\n", mc / 1000, (mc < 0 ? -mc : mc) % 1000);

    zassert_between_inclusive(mc, DIE_TEMP_MIN_MC, DIE_TEMP_MAX_MC,
                              "PMIC die temperature %d mC implausible", mc);
}

ZTEST(careloop_6_power, test_power_battery_voltage)
{
    struct sensor_value val;
    int32_t mv;

    zassert_ok(sensor_sample_fetch(charger), "charger sample fetch failed");
    zassert_ok(sensor_channel_get(charger, SENSOR_CHAN_GAUGE_VOLTAGE, &val),
               "battery voltage read failed");

    mv = sensor_value_to_milli(&val);
    printk("  battery %d.%03d V\n", mv / 1000, (mv < 0 ? -mv : mv) % 1000);

    zassert_between_inclusive(mv, VBAT_MIN_MV, VBAT_MAX_MV,
                              "battery %d mV outside %d..%d - is a cell fitted?",
                              mv, VBAT_MIN_MV, VBAT_MAX_MV);
}
```
